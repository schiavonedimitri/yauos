OUTPUT_FORMAT("elf32-i686", "elf32-i686", "elf32-i686")
OUTPUT_ARCH(i686)
ENTRY(_start)

KERNEL_PHYSICAL_BASE = 0x00100000;
KERNEL_VIRTUAL_BASE = 0xC0100000;

SECTIONS {

	. = KERNEL_VIRTUAL_BASE;
	_KERNEL_START_ = .;

	.text ALIGN(4K) : AT(ADDR(.text) - (KERNEL_VIRTUAL_BASE - KERNEL_PHYSICAL_BASE)) {
		_KERNEL_TEXT_START_ = .;
		*(.multiboot2)
		*(.text)
		_KERNEL_TEXT_END_ = .;
	}

	.rodata ALIGN(4K) : AT(ADDR(.rodata) - (KERNEL_VIRTUAL_BASE - KERNEL_PHYSICAL_BASE)) {
		_KERNEL_RODATA_START_ = .;
		*(.rodata)
		_KERNEL_RODATA_END_ = .;
	}

	.data ALIGN(4K) : AT(ADDR(.data) - (KERNEL_VIRTUAL_BASE - KERNEL_PHYSICAL_BASE)) {
		_KERNEL_DATA_START_ = .;
		*(.data)
		_KERNEL_DATA_END_ = .;
	}

	.bss ALIGN(4K) : AT(ADDR(.bss) - (KERNEL_VIRTUAL_BASE - KERNEL_PHYSICAL_BASE)) {
		_KERNEL_BSS_START_ = .;
		*(COMMON)
		*(.bss)
		_KERNEL_BSS_END_ = .;
	}
		_KERNEL_END_ = .;
}
